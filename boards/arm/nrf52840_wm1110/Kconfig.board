## boards/arm/nrf52840_wm1110/Kconfig.board
```kconfig
# nRF52840 DK NRF52840 board configuration

# Copyright (c) 2016 Nordic Semiconductor ASA
# SPDX-License-Identifier: Apache-2.0

config BOARD_NRF52840_WM1110
	bool "Nrf52840 Wm1110"
	depends on SOC_NRF52840_QIAA
```

## boards/arm/wio_wm1110/Kconfig.board
```kconfig
# nRF52840 DK NRF52840 board configuration

# Copyright (c) 2016 Nordic Semiconductor ASA
# SPDX-License-Identifier: Apache-2.0

config BOARD_WIO_WM1110
	bool "Wio Wm1110"
	depends on SOC_NRF52840_QIAA
```

## boards/arm/wio_wm1110/Kconfig.defconfig
```kconfig
# nRF52840 DK NRF52840 board configuration

# Copyright (c) 2016 Nordic Semiconductor ASA
# SPDX-License-Identifier: Apache-2.0

if BOARD_WIO_WM1110

config BOARD
	default "wio_wm1110"

config BT_CTLR
	default BT

endif # BOARD_WIO_WM1110
```

## samples/sid_nrf52840_wm1110/sample.yaml
```yaml
sample:
  name: Sidewalk end device sample
  description: Sample implementing Amazon Sidewalk End Device
tests:
  sample.sidewalk.hello:
    build_only: true
    platform_allow: nrf52840_wm1110
    extra_configs:
      - CONFIG_SID_END_DEVICE_PERSISTENT_LINK_MASK=y
    integration_platforms:
      - nrf52840_wm1110
    tags: Sidewalk hello

  sample.sidewalk.hello.release:
    build_only: true
    platform_allow: nrf52840_wm1110
    extra_args:
      CONF_FILE=prj_release.conf
    extra_configs:
      - CONFIG_SID_END_DEVICE_PERSISTENT_LINK_MASK=y
    integration_platforms:
      - nrf52840_wm1110
    tags: Sidewalk hello

  sample.sidewalk.hello.no_dfu:
    build_only: true
    platform_allow: nrf52840_wm1110
    extra_args:
      CONF_FILE=prj_no_dfu.conf
    extra_configs:
      - CONFIG_SID_END_DEVICE_PERSISTENT_LINK_MASK=y
    integration_platforms:
      - nrf52840_wm1110
    tags: Sidewalk hello

  sample.sidewalk.hello.ble_only:
    build_only: true
    platform_allow: nrf52840_wm1110
    extra_configs:
      - CONFIG_SIDEWALK_SUBGHZ_SUPPORT=n
    integration_platforms:
      - nrf52840_wm1110
    tags: Sidewalk hello BLE

  sample.sidewalk.hello.ble_only.release:
    build_only: true
    platform_allow: nrf52840_wm1110
    extra_args:
      CONF_FILE=prj_release.conf
    extra_configs:
      - CONFIG_SIDEWALK_SUBGHZ_SUPPORT=n
    integration_platforms:
      - nrf52840_wm1110
    tags: Sidewalk hello BLE

  sample.sidewalk.demo:
    build_only: true
    platform_allow: nrf52840_wm1110
    extra_args:
      OVERLAY_CONFIG="overlay-demo.conf"
    extra_configs:
      - CONFIG_SID_END_DEVICE_PERSISTENT_LINK_MASK=y
    integration_platforms:
      - nrf52840_wm1110
    tags: Sidewalk demo

  sample.sidewalk.demo.ble_only:
    build_only: true
    platform_allow: nrf52840_wm1110
    extra_args:
      OVERLAY_CONFIG="overlay-demo.conf"
    extra_configs:
      - CONFIG_SIDEWALK_SUBGHZ_SUPPORT=n
    integration_platforms:
      - nrf52840_wm1110
    tags: Sidewalk demo BLE

  sample.sidewalk.dut:
    build_only: true
    platform_allow: nrf52840_wm1110
    extra_args:
      OVERLAY_CONFIG="overlay-dut.conf"
    extra_configs:
      - CONFIG_SIDEWALK_FILE_TRANSFER=y
    integration_platforms:
      - nrf52840_wm1110
    tags: Sidewalk cli
```
