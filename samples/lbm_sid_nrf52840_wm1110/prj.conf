## CMakeLists.txt
```
#
# Copyright (c) 2023 Nordic Semiconductor ASA
#
# SPDX-License-Identifier: LicenseRef-Nordic-5-Clause
#

cmake_minimum_required(VERSION 3.20.0)


# Configurations
if(CONF_FILE)
    get_filename_component(CONFIG_FILE_NAME ${CONF_FILE} NAME)
endif()

if("${CONFIG_FILE_NAME}" STREQUAL "prj_no_dfu.conf")
    set(PM_STATIC_YML_FILE ${CMAKE_CURRENT_SOURCE_DIR}/configuration/pm_static_no_dfu.yml)
else()
    set(PM_STATIC_YML_FILE ${CMAKE_CURRENT_SOURCE_DIR}/configuration/${BOARD}/pm_static_dfu.yml)
endif()

# Zephyr CMake project
find_package(Zephyr REQUIRED HINTS $ENV{ZEPHYR_BASE})
project(sidewalk_sid_end_device)

# Source files
target_include_directories(app PRIVATE include)
target_sources(app PRIVATE
    src/main.c
    src/sidewalk.c
)

target_sources_ifdef(CONFIG_SIDEWALK_FILE_TRANSFER app PRIVATE src/file_transfer.c)

if(CONFIG_SID_END_DEVICE_SENSOR_MONITORING)
    target_sources(app PRIVATE
        src/sensor_monitoring/app_buttons.c
        src/sensor_monitoring/app_leds.c
        src/sensor_monitoring/app_sensor.c
        src/sensor_monitoring/app_tx.c
        src/sensor_monitoring/app_rx.c
        src/sensor_monitoring/app.c
    )
elseif(CONFIG_SID_END_DEVICE_DUT)
    target_sources(app PRIVATE
        src/cli/app.c
    )
elseif(CONFIG_LBM_END_DEVICE)
    target_sources(app PRIVATE
        src/lbm/app_lbm_sidewalk.c
        src/lbm/main_periodical_uplink.c
    )
	zephyr_compile_definitions(
		CRYPTO=SOFT
		RP2_103
		SMTC_D2D
		USER_DEFINED_JOIN_PARAMETERS
	)
	if (CONFIG_REGION_US_915)
		target_compile_definitions(app PRIVATE MODEM_EXAMPLE_REGION=SMTC_MODEM_REGION_US_915)
	else()
		message(SEND_ERROR "not us_915 region")
	endif()
elseif(CONFIG_SID_END_DEVICE_NAV3)
	if(CONFIG_NAV3_SEND)
		target_compile_definitions(app PRIVATE NAV3_SEND)
		target_sources(app PRIVATE src/lbm/wifi.c)
	elseif(CONFIG_NAV3_ONLY)
		target_compile_definitions(app PRIVATE NAV3_ONLY)
	endif()
    target_sources(app PRIVATE
        src/lbm/app_nav3_sidewalk.c
        src/lbm/main_geolocation_sidewalk.c
    )
	zephyr_compile_definitions(RP2_103)	# TODO why should this be necessary in bypass
	if (CONFIG_REGION_US_915)
		# TODO why should this be necessary in bypass
		target_compile_definitions(app PRIVATE MODEM_EXAMPLE_REGION=SMTC_MODEM_REGION_US_915)
	else()
		message(SEND_ERROR "not us_915 region")
	endif()
elseif(CONFIG_LBM_END_DEVICE_NAV3)
    target_sources(app PRIVATE
        src/lbm/app_nav3_lbm.c
        src/lbm/main_geolocation_lbm.c
    )
	zephyr_compile_definitions(RP2_103)
	if (CONFIG_REGION_US_915)
		target_compile_definitions(app PRIVATE MODEM_EXAMPLE_REGION=SMTC_MODEM_REGION_US_915)
	else()
		message(SEND_ERROR "not us_915 region")
	endif()
else()
    target_sources(app PRIVATE
        src/hello/app.c
    )
endif()

if(CONFIG_SID_END_DEVICE_CLI)
    target_sources(app PRIVATE
        src/cli/app_dut.c
        src/cli/app_shell.c
    )
endif()

if(CONFIG_SMTC_CLI)
    target_sources(app PRIVATE
		src/cli/smtc_shell.c
	)
	target_compile_definitions(app PRIVATE CONFIG_SMTC_CLI)
endif()
```

## prj.conf
```kconfig
#
# Copyright (c) 2023 Nordic Semiconductor ASA
#
# SPDX-License-Identifier: LicenseRef-Nordic-5-Clause
#

# Sidewalk
CONFIG_SIDEWALK=y
CONFIG_SMF=y

# CONFIG_SIDEWALK_LINK_MASK_FSK=y
CONFIG_SIDEWALK_LINK_MASK_LORA=y
CONFIG_RADIO_LR11XX=y
CONFIG_RADIO_TCXO=y
#CONFIG_SMTC_CLI=y
#CONFIG_SIDEWALK_THREAD_QUEUE_SIZE=20
#CONFIG_NAV3_SEND=y
CONFIG_NAV3_ONLY=y
#CONFIG_LBM_HAL_DBG_DEEP=y

# Log
CONFIG_LOG=y
CONFIG_LOG_PRINTK=y
CONFIG_LOG_BUFFER_SIZE=4096
CONFIG_NVS_LOG_LEVEL_WRN=y

# Bluetooth
CONFIG_BT_DEVICE_NAME="Nordic"

# Power Management
CONFIG_PM_DEVICE=y

# Debug
# CONFIG_RESET_ON_FATAL_ERROR=n
CONFIG_SYS_HEAP_RUNTIME_STATS=y


# USB DEVICE
CONFIG_USB_DEVICE_STACK=y
CONFIG_USB_CDC_ACM_LOG_LEVEL_OFF=y
CONFIG_USB_DEVICE_MANUFACTURER="Seeed Studio"
CONFIG_USB_DEVICE_PRODUCT="Asset Tracker"
CONFIG_USB_DEVICE_VID=0x2886
CONFIG_USB_DEVICE_PID=0x0052
CONFIG_RESET_ON_FATAL_ERROR=n
CONFIG_SYS_HEAP_RUNTIME_STATS=y


# MCUBOOT
CONFIG_BOOTLOADER_MCUBOOT=n

# DFU
CONFIG_SIDEWALK_DFU=n

# UF2
CONFIG_USE_DT_CODE_PARTITION=y
CONFIG_BUILD_OUTPUT_UF2=y
CONFIG_KERNEL_BIN_NAME="LbmSidEndDeviceApp"

CONFIG_HEAP_MEM_POOL_SIZE=12288

CONFIG_REBOOT=y
CONFIG_RESET_ON_FATAL_ERROR=y
CONFIG_LBM_REBOOT_ON_PANIC=y
```

## overlay-nav3sid.conf
```kconfig
CONFIG_SID_END_DEVICE_NAV3=y
#CONFIG_LORABASICSMODEM_V431=y
CONFIG_LORABASICSMODEM_V450=y
# lora basics modem debug
CONFIG_LBM_LOG_LEVEL_DBG=n
CONFIG_LBM_HAL_DBG=y
CONFIG_LBM_HAL_DBG_DEEP=n
# CONFIG_LBM_GNSS_ALMANAC_DEEP_DBG=y
CONFIG_NAV3_SEND=y

# default is 2048
CONFIG_LOG_BUFFER_SIZE=4096


CONFIG_SIDEWALK_LINK_MASK_LORA=y

# CONFIG_LBM_GNSS_SCAN_DEEP_DBG=y
```

## prj_no_dfu.conf
```kconfig
#
# Copyright (c) 2023 Nordic Semiconductor ASA
#
# SPDX-License-Identifier: LicenseRef-Nordic-5-Clause
#

# Sidewalk
CONFIG_SIDEWALK=y
CONFIG_SIDEWALK_DFU=n
CONFIG_SMF=y

# Log
CONFIG_LOG=y
CONFIG_LOG_PRINTK=y
CONFIG_LOG_BUFFER_SIZE=2048
CONFIG_NVS_LOG_LEVEL_WRN=y

# Bluetooth
CONFIG_BT_DEVICE_NAME="Nordic"

# Debug
CONFIG_RESET_ON_FATAL_ERROR=n


# USB DEVICE
CONFIG_USB_DEVICE_STACK=y
CONFIG_USB_CDC_ACM_LOG_LEVEL_OFF=y
CONFIG_USB_DEVICE_MANUFACTURER="Seeed Studio"
CONFIG_USB_DEVICE_PRODUCT="Asset Tracker"
CONFIG_USB_DEVICE_VID=0x2886
CONFIG_USB_DEVICE_PID=0x0052
CONFIG_RESET_ON_FATAL_ERROR=n
CONFIG_SYS_HEAP_RUNTIME_STATS=y


# MCUBOOT
CONFIG_BOOTLOADER_MCUBOOT=n

# DFU
CONFIG_SIDEWALK_DFU=n

# UF2
CONFIG_USE_DT_CODE_PARTITION=y
CONFIG_BUILD_OUTPUT_UF2=y
CONFIG_KERNEL_BIN_NAME="LbmSidEndDeviceApp"

CONFIG_HEAP_MEM_POOL_SIZE=12288
```

## prj_release.conf
```kconfig
#
# Copyright (c) 2022 Nordic Semiconductor ASA
#
# SPDX-License-Identifier: LicenseRef-Nordic-5-Clause
#

# Sidewalk
CONFIG_SIDEWALK=y
CONFIG_SMF=y

# Bluetooth
CONFIG_BT_DEVICE_NAME="Nordic"

# Disable peripherals
CONFIG_LOG=n
CONFIG_SERIAL=n
CONFIG_SHELL=n
CONFIG_CONSOLE=n
CONFIG_UART_CONSOLE=n
CONFIG_ASSERT=n
CONFIG_ASSERT_VERBOSE=n
CONFIG_ASSERT_NO_FILE_INFO=y
CONFIG_PRINTK_SYNC=n
CONFIG_THREAD_NAME=n

# Power Management
CONFIG_PM_DEVICE=y


# USB DEVICE
CONFIG_USB_DEVICE_STACK=y
CONFIG_USB_CDC_ACM_LOG_LEVEL_OFF=y
CONFIG_USB_DEVICE_MANUFACTURER="Seeed Studio"
CONFIG_USB_DEVICE_PRODUCT="Asset Tracker"
CONFIG_USB_DEVICE_VID=0x2886
CONFIG_USB_DEVICE_PID=0x0052
CONFIG_RESET_ON_FATAL_ERROR=n
CONFIG_SYS_HEAP_RUNTIME_STATS=y


# MCUBOOT
CONFIG_BOOTLOADER_MCUBOOT=n

# DFU
CONFIG_SIDEWALK_DFU=n

# UF2
CONFIG_USE_DT_CODE_PARTITION=y
CONFIG_BUILD_OUTPUT_UF2=y
CONFIG_KERNEL_BIN_NAME="LbmSidEndDeviceApp"

CONFIG_HEAP_MEM_POOL_SIZE=12288
```

## src/main.c
```c
/*
 * Copyright (c) 2023 Nordic Semiconductor ASA
 *
 * SPDX-License-Identifier: LicenseRef-Nordic-5-Clause
 */

#include <app.h>
#include <zephyr/logging/log.h>
#include <sidewalk_version.h>
#include <zephyr/device.h>
#include <zephyr/kernel.h>

#include <zephyr/logging/log.h>
LOG_MODULE_REGISTER(main, CONFIG_SIDEWALK_LOG_LEVEL);

int main(void)
{
	PRINT_SIDEWALK_VERSION();

	app_start();

	return 0;
}
```

## include/example_options.h
```c
/**
 * @file	  example_options.h
 *
 * @brief	 User options to be used in example applications
 *
 * The Clear BSD License
 * Copyright Semtech Corporation 2021. All rights reserved.
 *
 * Redistribution and use in source and binary forms, with or without
 * modification, are permitted (subject to the limitations in the disclaimer
 * below) provided that the following conditions are met:
 *	 * Redistributions of source code must retain the above copyright
 *	   notice, this list of conditions and the following disclaimer.
 *	 * Redistributions in binary form must reproduce the above copyright
 *	   notice, this list of conditions and the following disclaimer in the
 *	   documentation and/or other materials provided with the distribution.
 *	 * Neither the name of the Semtech corporation nor the
 *	   names of its contributors may be used to endorse or promote products
 *	   derived from this software without specific prior written permission.
 *
 * NO EXPRESS OR IMPLIED LICENSES TO ANY PARTY'S PATENT RIGHTS ARE GRANTED BY
 * THIS LICENSE. THIS SOFTWARE IS PROVIDED BY THE COPYRIGHT HOLDERS AND
 * CONTRIBUTORS "AS IS" AND ANY EXPRESS OR IMPLIED WARRANTIES, INCLUDING, BUT
 * NOT LIMITED TO, THE IMPLIED WARRANTIES OF MERCHANTABILITY AND FITNESS FOR A
 * PARTICULAR PURPOSE ARE DISCLAIMED. IN NO EVENT SHALL SEMTECH CORPORATION BE
 * LIABLE FOR ANY DIRECT, INDIRECT, INCIDENTAL, SPECIAL, EXEMPLARY, OR
 * CONSEQUENTIAL DAMAGES (INCLUDING, BUT NOT LIMITED TO, PROCUREMENT OF
 * SUBSTITUTE GOODS OR SERVICES; LOSS OF USE, DATA, OR PROFITS; OR BUSINESS
 * INTERRUPTION) HOWEVER CAUSED AND ON ANY THEORY OF LIABILITY, WHETHER IN
 * CONTRACT, STRICT LIABILITY, OR TORT (INCLUDING NEGLIGENCE OR OTHERWISE)
 * ARISING IN ANY WAY OUT OF THE USE OF THIS SOFTWARE, EVEN IF ADVISED OF THE
 * POSSIBILITY OF SUCH DAMAGE.
 */

#ifndef EXAMPLE_OPTIONS_H
#define EXAMPLE_OPTIONS_H

#ifdef __cplusplus
extern "C" {
#endif

/*
 * -----------------------------------------------------------------------------
 * --- DEPENDENCIES ------------------------------------------------------------
 */

#include <stdint.h>   // C99 types
#include <stdbool.h>  // bool type

#include "smtc_modem_api.h"

/*
 * -----------------------------------------------------------------------------
 * --- PUBLIC CONSTANTS --------------------------------------------------------
 */

/**
 * @brief LoRaWAN User credentials
 *		cd-zephyr-nov30
 * joineu 97742779212C2BB6
 * deveui 3BBE1562BCD35D32
 *	key 195029CB37A463742D063AF660281139
 */
// #define USER_LORAWAN_DEVICE_EUI						\
// 	{												  \
// 		0x3B, 0xBE, 0x15, 0x62, 0xBC, 0xD3, 0x5D, 0x32 \
// 	}
// #define USER_LORAWAN_JOIN_EUI						  \
// 	{												  \
// 		0x97, 0x74, 0x27, 0x79, 0x21, 0x2C, 0x2B, 0xB6 \
// 	}
// #define USER_LORAWAN_GEN_APP_KEY																	   \
// 	{																								  \
// 		0x19, 0x50, 0x29, 0xCB, 0x37, 0xA4, 0x63, 0x74, 0x2D, 0x06, 0x3A, 0xF6, 0x60, 0x28, 0x11, 0x39 \
// 	}
// #define USER_LORAWAN_APP_KEY																		   \
// 	{																								  \
// 		0x19, 0x50, 0x29, 0xCB, 0x37, 0xA4, 0x63, 0x74, 0x2D, 0x06, 0x3A, 0xF6, 0x60, 0x28, 0x11, 0x39 \
// 	}

/** Test */
// #define USER_LORAWAN_DEVICE_EUI						\
// 	{												  \
// 		0x70, 0xB3, 0xD5, 0x7E, 0xD0, 0x06, 0x23, 0xF1 \
// 	}
// #define USER_LORAWAN_JOIN_EUI						  \
// 	{												  \
// 		0x00, 0x00, 0x00, 0x00, 0x00, 0x00, 0x00, 0x00 \
// 	}
// #define USER_LORAWAN_GEN_APP_KEY																	   \
// 	{																								  \
// 		0x15, 0x6A, 0x53, 0x4A, 0x91, 0xA4, 0x25, 0x5D, 0x22, 0x47, 0x24, 0xAE, 0x3A, 0x69, 0x93, 0xDE \
// 	}
// #define USER_LORAWAN_APP_KEY																		   \
// 	{																								  \
// 		0x15, 0x6A, 0x53, 0x4A, 0x91, 0xA4, 0x25, 0x5D, 0x22, 0x47, 0x24, 0xAE, 0x3A, 0x69, 0x93, 0xDE \
// 	}


// /** Test001 */
// #define USER_LORAWAN_DEVICE_EUI						\
// 	{												  \
// 		0x70, 0xB3, 0xD5, 0x7E, 0xD0, 0x06, 0x23, 0xF2 \
// 	}
// #define USER_LORAWAN_JOIN_EUI						  \
// 	{												  \
// 		0x00, 0x00, 0x00, 0x00, 0x00, 0x00, 0x00, 0x00 \
// 	}
// #define USER_LORAWAN_GEN_APP_KEY																	   \
// 	{																								  \
// 		0x15, 0x6A, 0x53, 0x4A, 0x91, 0xA4, 0x25, 0x5D, 0x22, 0x47, 0x24, 0xAE, 0x3A, 0x69, 0x93, 0xD0 \
// 	}
// #define USER_LORAWAN_APP_KEY																		   \
// 	{																								  \
// 		0x15, 0x6A, 0x53, 0x4A, 0x91, 0xA4, 0x25, 0x5D, 0x22, 0x47, 0x24, 0xAE, 0x3A, 0x69, 0x93, 0xD0 \
// 	}


#define DEMO_TEST_004 // EmbeddedWorldTrackerDemo-001
// #define DEMO_TEST_002 // EmbeddedWorldTrackerDemo-002
// #define DEMO_TEST_003 // EmbeddedWorldTrackerDemo-003
// #define DEMO_TEST_004 // EmbeddedWorldTrackerDemo-004
// #define DEMO_TEST_005 // EmbeddedWorldTrackerDemo-005
// #define DEMO_TEST_006 // EmbeddedWorldTrackerDemo-006
// #define DEMO_TEST_007 // EmbeddedWorldTrackerDemo-007
// #define DEMO_TEST_008 // EmbeddedWorldTrackerDemo-008
// #define DEMO_TEST_009 // EmbeddedWorldTrackerDemo-009

#if defined( DEMO_TEST_001 )
#define USER_LORAWAN_DEVICE_EUI                        \
    {                                                  \
        0x70, 0xB3, 0xD5, 0x7E, 0xD0, 0x05, 0x04, 0x17 \
    }
#elif defined( DEMO_TEST_002 )
#define USER_LORAWAN_DEVICE_EUI                        \
    {                                                  \
        0x70, 0xB3, 0xD5, 0x7E, 0xD0, 0x05, 0x04, 0x02 \
    }
#elif defined( DEMO_TEST_003 )
#define USER_LORAWAN_DEVICE_EUI                        \
    {                                                  \
        0x70, 0xB3, 0xD5, 0x7E, 0xD0, 0x05, 0x04, 0x03 \
    }
#elif defined( DEMO_TEST_004 )
#define USER_LORAWAN_DEVICE_EUI                        \
    {                                                  \
        0x70, 0xB3, 0xD5, 0x7E, 0xD0, 0x05, 0x04, 0x04 \
    }
#elif defined( DEMO_TEST_005 )
#define USER_LORAWAN_DEVICE_EUI                        \
    {                                                  \
        0x70, 0xB3, 0xD5, 0x7E, 0xD0, 0x05, 0x04, 0x05 \
    }
#elif defined( DEMO_TEST_006 )
#define USER_LORAWAN_DEVICE_EUI                        \
    {                                                  \
        0x70, 0xB3, 0xD5, 0x7E, 0xD0, 0x05, 0x04, 0x06 \
    }
#elif defined( DEMO_TEST_007 )
#define USER_LORAWAN_DEVICE_EUI                        \
    {                                                  \
        0x70, 0xB3, 0xD5, 0x7E, 0xD0, 0x05, 0x04, 0x07 \
    }
#elif defined( DEMO_TEST_008 )
#define USER_LORAWAN_DEVICE_EUI                        \
    {                                                  \
        0x70, 0xB3, 0xD5, 0x7E, 0xD0, 0x05, 0x04, 0x08 \
    }
#elif defined( DEMO_TEST_009 )
#define USER_LORAWAN_DEVICE_EUI                        \
    {                                                  \
        0x70, 0xB3, 0xD5, 0x7E, 0xD0, 0x05, 0x04, 0x09 \
    }
#else
#define USER_LORAWAN_DEVICE_EUI                        \
    {                                                  \
        0x00, 0x00, 0x00, 0x00, 0x00, 0x00, 0x00, 0x00 \
    }
#endif

#define USER_LORAWAN_JOIN_EUI                          \
    {                                                  \
        0x00, 0x00, 0x00, 0x00, 0x00, 0x00, 0x00, 0x00 \
    }

#define USER_LORAWAN_GEN_APP_KEY                                                                       \
    {                                                                                                  \
        0xEC, 0x6B, 0x10, 0x47, 0xB7, 0x6B, 0x2C, 0x3C, 0x92, 0xCF, 0x9A, 0x12, 0x8A, 0x5C, 0xCF, 0xEB \
    }

#define USER_LORAWAN_APP_KEY                                                                           \
    {                                                                                                  \
        0xEC, 0x6B, 0x10, 0x47, 0xB7, 0x6B, 0x2C, 0x3C, 0x92, 0xCF, 0x9A, 0x12, 0x8A, 0x5C, 0xCF, 0xEB \
    }

/**
 * @brief Modem Region define
 */
#ifndef MODEM_EXAMPLE_REGION
#if !defined( SX128X )
#define MODEM_EXAMPLE_REGION SMTC_MODEM_REGION_EU_868
#else
#define MODEM_EXAMPLE_REGION SMTC_MODEM_REGION_WW2G4
#endif
#endif  // MODEM_EXAMPLE_REGION
// clang-format on

#ifdef __cplusplus
}
#endif

#endif  // EXAMPLE_OPTIONS_H

/* --- EOF ------------------------------------------------------------------ */
```
